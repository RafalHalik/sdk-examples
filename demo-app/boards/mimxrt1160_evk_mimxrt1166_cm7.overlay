/*
 * Copyright 2024, NXP
 *
 * SPDX-License-Identifier: Apache-2.0
 */
nxp_mipi_i2c: &lpi2c5 {
	status = "okay";
};
&zephyr_mipi_dsi {
	/* Raise the DSI clock frequency */
	phy-clock = <792000000>;
};
