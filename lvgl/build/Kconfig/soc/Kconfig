## lvgl/build/Kconfig/soc/Kconfig
```kconfig
# Load Zephyr SoC Kconfig descriptions.
osource "/workdir/zephyr/soc/cdns/dc233c/Kconfig"
osource "/workdir/zephyr/soc/cdns/xtensa_sample_controller/Kconfig"
osource "/workdir/zephyr/soc/rockchip/Kconfig"
osource "/workdir/zephyr/soc/starfive/jh71xx/Kconfig"
osource "/workdir/zephyr/soc/nxp/kinetis/Kconfig"
osource "/workdir/zephyr/soc/nxp/lpc/Kconfig"
osource "/workdir/zephyr/soc/nxp/imx/Kconfig"
osource "/workdir/zephyr/soc/nxp/imxrt/Kconfig"
osource "/workdir/zephyr/soc/nxp/layerscape/Kconfig"
osource "/workdir/zephyr/soc/nxp/s32/Kconfig"
osource "/workdir/zephyr/soc/quicklogic/eos_s3/Kconfig"
osource "/workdir/zephyr/soc/ite/ec/Kconfig"
osource "/workdir/zephyr/soc/brcm/bcmvk/Kconfig"
osource "/workdir/zephyr/soc/brcm/bcm2711/Kconfig"
osource "/workdir/zephyr/soc/telink/tlsr/Kconfig"
osource "/workdir/zephyr/soc/renesas/rzt2m/Kconfig"
osource "/workdir/zephyr/soc/renesas/ra/Kconfig"
osource "/workdir/zephyr/soc/renesas/rcar/Kconfig"
osource "/workdir/zephyr/soc/renesas/smartbond/Kconfig"
osource "/workdir/zephyr/soc/silabs/Kconfig"
osource "/workdir/zephyr/soc/ti/lm3s6965/Kconfig"
osource "/workdir/zephyr/soc/ti/simplelink/Kconfig"
osource "/workdir/zephyr/soc/ti/k3/Kconfig"
osource "/workdir/zephyr/soc/sifive/sifive_freedom/Kconfig"
osource "/workdir/zephyr/soc/gaisler/gr716a/Kconfig"
osource "/workdir/zephyr/soc/gaisler/leon3/Kconfig"
osource "/workdir/zephyr/soc/nuvoton/npcx/Kconfig"
osource "/workdir/zephyr/soc/nuvoton/numaker/Kconfig"
osource "/workdir/zephyr/soc/nuvoton/numicro/Kconfig"
osource "/workdir/zephyr/soc/altr/zephyr_nios2f/Kconfig"
osource "/workdir/zephyr/soc/altr/qemu_nios2/Kconfig"
osource "/workdir/zephyr/soc/renode/riscv_virtual/Kconfig"
osource "/workdir/zephyr/soc/arm/beetle/Kconfig"
osource "/workdir/zephyr/soc/arm/Kconfig"
osource "/workdir/zephyr/soc/synopsys/emsk/Kconfig"
osource "/workdir/zephyr/soc/synopsys/arc_iot/Kconfig"
osource "/workdir/zephyr/soc/synopsys/emsdp/Kconfig"
osource "/workdir/zephyr/soc/synopsys/hsdk/Kconfig"
osource "/workdir/zephyr/soc/synopsys/qemu_arc/Kconfig"
osource "/workdir/zephyr/soc/synopsys/nsim/Kconfig"
osource "/workdir/zephyr/soc/synopsys/hsdk4xd/Kconfig"
osource "/workdir/zephyr/soc/openisa/rv32m1/Kconfig"
osource "/workdir/zephyr/soc/neorv32/Kconfig"
osource "/workdir/zephyr/soc/intel/intel_ish/Kconfig"
osource "/workdir/zephyr/soc/intel/raptor_lake/Kconfig"
osource "/workdir/zephyr/soc/intel/intel_adsp/Kconfig"
osource "/workdir/zephyr/soc/intel/intel_socfpga/Kconfig"
osource "/workdir/zephyr/soc/intel/lakemont/Kconfig"
osource "/workdir/zephyr/soc/intel/atom/Kconfig"
osource "/workdir/zephyr/soc/intel/elkhart_lake/Kconfig"
osource "/workdir/zephyr/soc/intel/apollo_lake/Kconfig"
osource "/workdir/zephyr/soc/intel/intel_niosv/Kconfig"
osource "/workdir/zephyr/soc/intel/intel_socfpga_std/Kconfig"
osource "/workdir/zephyr/soc/intel/alder_lake/Kconfig"
osource "/workdir/zephyr/soc/cypress/Kconfig"
osource "/workdir/zephyr/soc/xen/Kconfig"
osource "/workdir/zephyr/soc/espressif/Kconfig"
osource "/workdir/zephyr/soc/xlnx/zynq7000/Kconfig"
osource "/workdir/zephyr/soc/xlnx/zynqmp/Kconfig"
osource "/workdir/zephyr/soc/efinix/sapphire/Kconfig"
osource "/workdir/zephyr/soc/andestech/Kconfig"
osource "/workdir/zephyr/soc/riscv/qemu_virt_riscv/Kconfig"
osource "/workdir/zephyr/soc/ambiq/Kconfig"
osource "/workdir/zephyr/soc/nordic/Kconfig"
osource "/workdir/zephyr/soc/infineon/xmc/Kconfig"
osource "/workdir/zephyr/soc/raspberrypi/Kconfig"
osource "/workdir/zephyr/soc/st/stm32/Kconfig"
osource "/workdir/zephyr/soc/microchip/miv/Kconfig"
osource "/workdir/zephyr/soc/microchip/mec/Kconfig"
osource "/workdir/zephyr/soc/gd/gd32/Kconfig"
osource "/workdir/zephyr/soc/aspeed/Kconfig"
osource "/workdir/zephyr/soc/litex/litex_vexriscv/Kconfig"
osource "/workdir/zephyr/soc/atmel/sam0/Kconfig"
osource "/workdir/zephyr/soc/atmel/sam/Kconfig"
osource "/workdir/zephyr/soc/native/inf_clock/Kconfig"
osource "/workdir/zephyr/soc/qemu_malta/Kconfig"
osource "/workdir/zephyr/soc/lowrisc/opentitan/Kconfig"
```

## lvgl/build/Kconfig/soc/Kconfig.defconfig
```kconfig
# Load Zephyr SoC Kconfig defconfig.
osource "/workdir/zephyr/soc/cdns/dc233c/Kconfig.defconfig"
osource "/workdir/zephyr/soc/cdns/xtensa_sample_controller/Kconfig.defconfig"
osource "/workdir/zephyr/soc/rockchip/Kconfig.defconfig"
osource "/workdir/zephyr/soc/starfive/jh71xx/Kconfig.defconfig"
osource "/workdir/zephyr/soc/nxp/kinetis/Kconfig.defconfig"
osource "/workdir/zephyr/soc/nxp/lpc/Kconfig.defconfig"
osource "/workdir/zephyr/soc/nxp/imx/Kconfig.defconfig"
osource "/workdir/zephyr/soc/nxp/imxrt/Kconfig.defconfig"
osource "/workdir/zephyr/soc/nxp/layerscape/Kconfig.defconfig"
osource "/workdir/zephyr/soc/nxp/s32/Kconfig.defconfig"
osource "/workdir/zephyr/soc/quicklogic/eos_s3/Kconfig.defconfig"
osource "/workdir/zephyr/soc/ite/ec/Kconfig.defconfig"
osource "/workdir/zephyr/soc/brcm/bcmvk/Kconfig.defconfig"
osource "/workdir/zephyr/soc/brcm/bcm2711/Kconfig.defconfig"
osource "/workdir/zephyr/soc/telink/tlsr/Kconfig.defconfig"
osource "/workdir/zephyr/soc/renesas/rzt2m/Kconfig.defconfig"
osource "/workdir/zephyr/soc/renesas/ra/Kconfig.defconfig"
osource "/workdir/zephyr/soc/renesas/rcar/Kconfig.defconfig"
osource "/workdir/zephyr/soc/renesas/smartbond/Kconfig.defconfig"
osource "/workdir/zephyr/soc/silabs/Kconfig.defconfig"
osource "/workdir/zephyr/soc/ti/lm3s6965/Kconfig.defconfig"
osource "/workdir/zephyr/soc/ti/simplelink/Kconfig.defconfig"
osource "/workdir/zephyr/soc/ti/k3/Kconfig.defconfig"
osource "/workdir/zephyr/soc/sifive/sifive_freedom/Kconfig.defconfig"
osource "/workdir/zephyr/soc/gaisler/gr716a/Kconfig.defconfig"
osource "/workdir/zephyr/soc/gaisler/leon3/Kconfig.defconfig"
osource "/workdir/zephyr/soc/nuvoton/npcx/Kconfig.defconfig"
osource "/workdir/zephyr/soc/nuvoton/numaker/Kconfig.defconfig"
osource "/workdir/zephyr/soc/nuvoton/numicro/Kconfig.defconfig"
osource "/workdir/zephyr/soc/altr/zephyr_nios2f/Kconfig.defconfig"
osource "/workdir/zephyr/soc/altr/qemu_nios2/Kconfig.defconfig"
osource "/workdir/zephyr/soc/renode/riscv_virtual/Kconfig.defconfig"
osource "/workdir/zephyr/soc/arm/beetle/Kconfig.defconfig"
osource "/workdir/zephyr/soc/arm/Kconfig.defconfig"
osource "/workdir/zephyr/soc/synopsys/emsk/Kconfig.defconfig"
osource "/workdir/zephyr/soc/synopsys/arc_iot/Kconfig.defconfig"
osource "/workdir/zephyr/soc/synopsys/emsdp/Kconfig.defconfig"
osource "/workdir/zephyr/soc/synopsys/hsdk/Kconfig.defconfig"
osource "/workdir/zephyr/soc/synopsys/qemu_arc/Kconfig.defconfig"
osource "/workdir/zephyr/soc/synopsys/nsim/Kconfig.defconfig"
osource "/workdir/zephyr/soc/synopsys/hsdk4xd/Kconfig.defconfig"
osource "/workdir/zephyr/soc/openisa/rv32m1/Kconfig.defconfig"
osource "/workdir/zephyr/soc/neorv32/Kconfig.defconfig"
osource "/workdir/zephyr/soc/intel/intel_ish/Kconfig.defconfig"
osource "/workdir/zephyr/soc/intel/raptor_lake/Kconfig.defconfig"
osource "/workdir/zephyr/soc/intel/intel_adsp/Kconfig.defconfig"
osource "/workdir/zephyr/soc/intel/intel_socfpga/Kconfig.defconfig"
osource "/workdir/zephyr/soc/intel/lakemont/Kconfig.defconfig"
osource "/workdir/zephyr/soc/intel/atom/Kconfig.defconfig"
osource "/workdir/zephyr/soc/intel/elkhart_lake/Kconfig.defconfig"
osource "/workdir/zephyr/soc/intel/apollo_lake/Kconfig.defconfig"
osource "/workdir/zephyr/soc/intel/intel_niosv/Kconfig.defconfig"
osource "/workdir/zephyr/soc/intel/intel_socfpga_std/Kconfig.defconfig"
osource "/workdir/zephyr/soc/intel/alder_lake/Kconfig.defconfig"
osource "/workdir/zephyr/soc/cypress/Kconfig.defconfig"
osource "/workdir/zephyr/soc/xen/Kconfig.defconfig"
osource "/workdir/zephyr/soc/espressif/Kconfig.defconfig"
osource "/workdir/zephyr/soc/xlnx/zynq7000/Kconfig.defconfig"
osource "/workdir/zephyr/soc/xlnx/zynqmp/Kconfig.defconfig"
osource "/workdir/zephyr/soc/efinix/sapphire/Kconfig.defconfig"
osource "/workdir/zephyr/soc/andestech/Kconfig.defconfig"
osource "/workdir/zephyr/soc/riscv/qemu_virt_riscv/Kconfig.defconfig"
osource "/workdir/zephyr/soc/ambiq/Kconfig.defconfig"
osource "/workdir/zephyr/soc/nordic/Kconfig.defconfig"
osource "/workdir/zephyr/soc/infineon/xmc/Kconfig.defconfig"
osource "/workdir/zephyr/soc/raspberrypi/Kconfig.defconfig"
osource "/workdir/zephyr/soc/st/stm32/Kconfig.defconfig"
osource "/workdir/zephyr/soc/microchip/miv/Kconfig.defconfig"
osource "/workdir/zephyr/soc/microchip/mec/Kconfig.defconfig"
osource "/workdir/zephyr/soc/gd/gd32/Kconfig.defconfig"
osource "/workdir/zephyr/soc/aspeed/Kconfig.defconfig"
osource "/workdir/zephyr/soc/litex/litex_vexriscv/Kconfig.defconfig"
osource "/workdir/zephyr/soc/atmel/sam0/Kconfig.defconfig"
osource "/workdir/zephyr/soc/atmel/sam/Kconfig.defconfig"
osource "/workdir/zephyr/soc/native/inf_clock/Kconfig.defconfig"
osource "/workdir/zephyr/soc/qemu_malta/Kconfig.defconfig"
osource "/workdir/zephyr/soc/lowrisc/opentitan/Kconfig.defconfig"
```

## lvgl/build/Kconfig/soc/Kconfig.sysbuild
```kconfig
# Load SoC sysbuild Kconfig descriptions.
osource "/workdir/zephyr/soc/xlnx/zynqmp/Kconfig.sysbuild"
osource "/workdir/zephyr/soc/xlnx/zynq7000/Kconfig.sysbuild"
osource "/workdir/zephyr/soc/xen/Kconfig.sysbuild"
osource "/workdir/zephyr/soc/ti/simplelink/Kconfig.sysbuild"
osource "/workdir/zephyr/soc/ti/lm3s6965/Kconfig.sysbuild"
osource "/workdir/zephyr/soc/ti/k3/Kconfig.sysbuild"
osource "/workdir/zephyr/soc/telink/tlsr/Kconfig.sysbuild"
osource "/workdir/zephyr/soc/starfive/jh71xx/Kconfig.sysbuild"
osource "/workdir/zephyr/soc/st/stm32/Kconfig.sysbuild"
osource "/workdir/zephyr/soc/snps/qemu_arc/Kconfig.sysbuild"
osource "/workdir/zephyr/soc/snps/nsim/arc_v/Kconfig.sysbuild"
osource "/workdir/zephyr/soc/snps/nsim/arc_classic/Kconfig.sysbuild"
osource "/workdir/zephyr/soc/snps/hsdk4xd/Kconfig.sysbuild"
osource "/workdir/zephyr/soc/snps/hsdk/Kconfig.sysbuild"
osource "/workdir/zephyr/soc/snps/emsk/Kconfig.sysbuild"
osource "/workdir/zephyr/soc/snps/emsdp/Kconfig.sysbuild"
osource "/workdir/zephyr/soc/snps/arc_iot/Kconfig.sysbuild"
osource "/workdir/zephyr/soc/silabs/Kconfig.sysbuild"
osource "/workdir/zephyr/soc/sifive/sifive_freedom/Kconfig.sysbuild"
osource "/workdir/zephyr/soc/rockchip/Kconfig.sysbuild"
osource "/workdir/zephyr/soc/renode/riscv_virtual/Kconfig.sysbuild"
osource "/workdir/zephyr/soc/renesas/smartbond/Kconfig.sysbuild"
osource "/workdir/zephyr/soc/renesas/rzt2m/Kconfig.sysbuild"
osource "/workdir/zephyr/soc/renesas/rcar/Kconfig.sysbuild"
osource "/workdir/zephyr/soc/renesas/ra/Kconfig.sysbuild"
osource "/workdir/zephyr/soc/raspberrypi/Kconfig.sysbuild"
osource "/workdir/zephyr/soc/quicklogic/eos_s3/Kconfig.sysbuild"
osource "/workdir/zephyr/soc/qemu/virt_riscv/Kconfig.sysbuild"
osource "/workdir/zephyr/soc/qemu/malta/Kconfig.sysbuild"
osource "/workdir/zephyr/soc/openisa/rv32m1/Kconfig.sysbuild"
osource "/workdir/zephyr/soc/nxp/s32/Kconfig.sysbuild"
osource "/workdir/zephyr/soc/nxp/rw/Kconfig.sysbuild"
osource "/workdir/zephyr/soc/nxp/mcx/Kconfig.sysbuild"
osource "/workdir/zephyr/soc/nxp/lpc/Kconfig.sysbuild"
osource "/workdir/zephyr/soc/nxp/layerscape/Kconfig.sysbuild"
osource "/workdir/zephyr/soc/nxp/kinetis/Kconfig.sysbuild"
osource "/workdir/zephyr/soc/nxp/imxrt/Kconfig.sysbuild"
osource "/workdir/zephyr/soc/nxp/imx/Kconfig.sysbuild"
osource "/workdir/zephyr/soc/nuvoton/numicro/Kconfig.sysbuild"
osource "/workdir/zephyr/soc/nuvoton/numaker/Kconfig.sysbuild"
osource "/workdir/zephyr/soc/nuvoton/npcx/Kconfig.sysbuild"
osource "/workdir/zephyr/soc/nordic/Kconfig.sysbuild"
osource "/workdir/zephyr/soc/neorv32/Kconfig.sysbuild"
osource "/workdir/zephyr/soc/native/inf_clock/Kconfig.sysbuild"
osource "/workdir/zephyr/soc/microchip/miv/Kconfig.sysbuild"
osource "/workdir/zephyr/soc/microchip/mec/Kconfig.sysbuild"
osource "/workdir/zephyr/soc/mediatek/mtk_adsp/Kconfig.sysbuild"
osource "/workdir/zephyr/soc/lowrisc/opentitan/Kconfig.sysbuild"
osource "/workdir/zephyr/soc/litex/litex_vexriscv/Kconfig.sysbuild"
osource "/workdir/zephyr/soc/ite/ec/Kconfig.sysbuild"
osource "/workdir/zephyr/soc/intel/raptor_lake/Kconfig.sysbuild"
osource "/workdir/zephyr/soc/intel/lakemont/Kconfig.sysbuild"
osource "/workdir/zephyr/soc/intel/intel_socfpga_std/Kconfig.sysbuild"
osource "/workdir/zephyr/soc/intel/intel_socfpga/Kconfig.sysbuild"
osource "/workdir/zephyr/soc/intel/intel_niosv/Kconfig.sysbuild"
osource "/workdir/zephyr/soc/intel/intel_ish/Kconfig.sysbuild"
osource "/workdir/zephyr/soc/intel/intel_adsp/Kconfig.sysbuild"
osource "/workdir/zephyr/soc/intel/elkhart_lake/Kconfig.sysbuild"
osource "/workdir/zephyr/soc/intel/atom/Kconfig.sysbuild"
osource "/workdir/zephyr/soc/intel/apollo_lake/Kconfig.sysbuild"
osource "/workdir/zephyr/soc/intel/alder_lake/Kconfig.sysbuild"
osource "/workdir/zephyr/soc/infineon/cat3/Kconfig.sysbuild"
osource "/workdir/zephyr/soc/infineon/cat1b/Kconfig.sysbuild"
osource "/workdir/zephyr/soc/infineon/cat1a/Kconfig.sysbuild"
osource "/workdir/zephyr/soc/gd/gd32/Kconfig.sysbuild"
osource "/workdir/zephyr/soc/gaisler/leon3/Kconfig.sysbuild"
osource "/workdir/zephyr/soc/gaisler/gr716a/Kconfig.sysbuild"
osource "/workdir/zephyr/soc/espressif/Kconfig.sysbuild"
osource "/workdir/zephyr/soc/ene/kb1200/Kconfig.sysbuild"
osource "/workdir/zephyr/soc/efinix/sapphire/Kconfig.sysbuild"
osource "/workdir/zephyr/soc/cdns/xtensa_sample_controller/Kconfig.sysbuild"
osource "/workdir/zephyr/soc/cdns/dc233c/Kconfig.sysbuild"
osource "/workdir/zephyr/soc/brcm/bcmvk/Kconfig.sysbuild"
osource "/workdir/zephyr/soc/brcm/bcm2712/Kconfig.sysbuild"
osource "/workdir/zephyr/soc/brcm/bcm2711/Kconfig.sysbuild"
osource "/workdir/zephyr/soc/atmel/sam0/Kconfig.sysbuild"
osource "/workdir/zephyr/soc/atmel/sam/Kconfig.sysbuild"
osource "/workdir/zephyr/soc/aspeed/Kconfig.sysbuild"
osource "/workdir/zephyr/soc/arm/Kconfig.sysbuild"
osource "/workdir/zephyr/soc/arm/beetle/Kconfig.sysbuild"
osource "/workdir/zephyr/soc/andestech/Kconfig.sysbuild"
osource "/workdir/zephyr/soc/ambiq/Kconfig.sysbuild"
osource "/workdir/zephyr/soc/altr/zephyr_nios2f/Kconfig.sysbuild"
osource "/workdir/zephyr/soc/altr/qemu_nios2/Kconfig.sysbuild"
osource "/workdir/zephyr/soc/adi/max32/Kconfig.sysbuild"
```
