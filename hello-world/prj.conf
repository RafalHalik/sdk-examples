## CMakeLists.txt
```
# SPDX-License-Identifier: Apache-2.0

cmake_minimum_required(VERSION 3.20.0)

set(ZEPHYR_EXTRA_MODULES "${CMAKE_SOURCE_DIR}/../../modules/bsp" )

find_package(Zephyr REQUIRED HINTS $ENV{ZEPHYR_BASE})

project(app)

target_sources(app PRIVATE src/main.c)
target_compile_definitions(app PRIVATE LV_LVGL_H_INCLUDE_SIMPLE)
```

## prj.conf
```kconfig
CONFIG_ASSERT=y
CONFIG_SYS_CLOCK_HW_CYCLES_PER_SEC=492000000

CONFIG_FLASH=y
# IMPORTANT NOTE: Flash shell does not work with bootloader; disable when 
# the application is run from the secondary bootloader
CONFIG_FLASH_SHELL=n
CONFIG_FLASH_SHELL_TEST_COMMANDS=n

# Bootloader
CONFIG_BOOTLOADER_MCUBOOT=n
CONFIG_MCUBOOT_GENERATE_UNSIGNED_IMAGE=n
CONFIG_MCUBOOT_BOOTLOADER_MODE_DIRECT_XIP=n


CONFIG_LOG=y
CONFIG_HWINFO=y
# Float log support
CONFIG_CBPRINTF_FP_SUPPORT=y
CONFIG_LOG_BUFFER_SIZE=4096
CONFIG_INIT_STACKS=y

CONFIG_GPIO=y
CONFIG_GPIO_SHELL=y

CONFIG_CONSOLE=y
CONFIG_UART_CONSOLE=y
CONFIG_SHELL=y
CONFIG_SHELL_STACK_SIZE=4096
CONFIG_SHELL_PROMPT_UART="proto:~$"

CONFIG_DMA=y
CONFIG_SYSTEM_WORKQUEUE_STACK_SIZE=4096
CONFIG_PWM=y

CONFIG_SPI=y
CONFIG_MODBUS=y

CONFIG_CAN=y
CONFIG_CAN_SHELL=y
# errors with prioroty otherwise
CONFIG_CAN_TRANSCEIVER_INIT_PRIORITY=80 

CONFIG_DRV8844=y
CONFIG_NAFE13388=y

# Hardware timer driver is enabled by COUNTER switch
CONFIG_COUNTER=y

CONFIG_NUM_COOP_PRIORITIES=29
CONFIG_NUM_PREEMPT_PRIORITIES=40
CONFIG_THREAD_NAME=y
CONFIG_REBOOT=y
CONFIG_THREAD_STACK_INFO=y
CONFIG_THREAD_RUNTIME_STATS=y
CONFIG_HW_STACK_PROTECTION=y

CONFIG_FAULT_DUMP=2
CONFIG_RUNTIME_ERROR_CHECKS=y
CONFIG_DEBUG_THREAD_INFO=y
CONFIG_PRINTK=y

CONFIG_NO_OPTIMIZATIONS=y
CONFIG_MAIN_STACK_SIZE=8192
CONFIG_HEAP_MEM_POOL_SIZE=262144
CONFIG_IDLE_STACK_SIZE=4096

# Flash
CONFIG_MEMC=y
CONFIG_FLASH_MCUX_FLEXSPI_NOR_WRITE_BUFFER=n

# I2C EEPROM, GPIO expander
CONFIG_I2C=y
CONFIG_I2C_SHELL=y

CONFIG_EEPROM=n

# GPIO_PCA953X
CONFIG_GPIO_LOG_LEVEL_DBG=n

# LED Driver
CONFIG_LED=y


# LVGL
CONFIG_MCUX_ELCDIF_PXP=y
CONFIG_DISPLAY=y
CONFIG_DISPLAY_INIT_PRIORITY=80
CONFIG_DISPLAY_LOG_LEVEL_ERR=y
CONFIG_DISPLAY=y
CONFIG_DISPLAY_MCUX_ELCDIF=y

CONFIG_LVGL=y
CONFIG_LV_MEM_CUSTOM=y
CONFIG_LV_USE_LOG=y
CONFIG_LV_USE_LABEL=y
CONFIG_LV_USE_BTN=y
CONFIG_LV_USE_ARC=y
CONFIG_LV_USE_IMG=y
CONFIG_LV_USE_MONKEY=y
CONFIG_LV_FONT_MONTSERRAT_14=y
CONFIG_LV_Z_MEM_POOL_SIZE=52224


# Configs from shield rk043fn66hs_ctg's defconfig
CONFIG_LV_Z_VDB_SIZE=100
CONFIG_LV_Z_DOUBLE_VDB=y
CONFIG_LV_Z_FULL_REFRESH=y
CONFIG_LV_Z_BITS_PER_PIXEL=32
CONFIG_LV_DPI_DEF=128
CONFIG_LV_Z_FLUSH_THREAD=n
CONFIG_LV_Z_VDB_ALIGN=32

CONFIG_LV_Z_MEM_POOL_SIZE=52224 
# CONFIG_LV_Z_FLUSH_THREAD_STACK_SIZE=8192
CONFIG_LV_Z_MEM_POOL_SYS_HEAP=y
CONFIG_LV_COLOR_DEPTH_32=y

CONFIG_LV_USE_PERF_MONITOR=y
# CONFIG_LV_USE_PXP=y - NO PXP...
```

## boards/mimxrt1160_c4p3_mimxrt1166_cm7.conf
```kconfig
CONFIG_ASSERT=y
CONFIG_SYS_CLOCK_HW_CYCLES_PER_SEC=492000000

CONFIG_FLASH=y
CONFIG_LOG=y
CONFIG_HWINFO=y
# Float log support
CONFIG_CBPRINTF_FP_SUPPORT=y
CONFIG_LOG_BUFFER_SIZE=6096
CONFIG_INIT_STACKS=y

CONFIG_GPIO=y
CONFIG_GPIO_SHELL=y

CONFIG_CONSOLE=y
CONFIG_UART_CONSOLE=y
CONFIG_SHELL=y
CONFIG_SHELL_STACK_SIZE=9096
CONFIG_SHELL_PROMPT_UART="proto:~$"

CONFIG_EVENTS=y
CONFIG_DMA=y
CONFIG_SYSTEM_WORKQUEUE_STACK_SIZE=9096
CONFIG_PWM=y

CONFIG_SPI=y
CONFIG_MODBUS=y


CONFIG_CAN=y
CONFIG_CAN_SHELL=y
# errors with prioroty otherwise
CONFIG_CAN_TRANSCEIVER_INIT_PRIORITY=80 

CONFIG_DRV8844=y
CONFIG_NAFE13388=y

# Hardware timer driver is enabled by COUNTER switch
CONFIG_COUNTER=y

CONFIG_NUM_COOP_PRIORITIES=29
CONFIG_NUM_PREEMPT_PRIORITIES=40
CONFIG_THREAD_NAME=y
CONFIG_REBOOT=y
CONFIG_THREAD_STACK_INFO=y
CONFIG_THREAD_RUNTIME_STATS=y
CONFIG_HW_STACK_PROTECTION=y

CONFIG_FAULT_DUMP=2
CONFIG_RUNTIME_ERROR_CHECKS=y
CONFIG_DEBUG_THREAD_INFO=y
CONFIG_PRINTK=y

CONFIG_NO_OPTIMIZATIONS=y
CONFIG_MAIN_STACK_SIZE=27192
CONFIG_HEAP_MEM_POOL_SIZE=412144
CONFIG_IDLE_STACK_SIZE=27096

# Flash
CONFIG_MEMC=y
CONFIG_FLASH_MCUX_FLEXSPI_NOR_WRITE_BUFFER=n

# I2C EEPROM, GPIO expander
CONFIG_I2C=y
CONFIG_I2C_SHELL=y

CONFIG_EEPROM=y

# GPIO_PCA953X
CONFIG_GPIO_LOG_LEVEL_DBG=n

# LED Driver
CONFIG_LED=y

CONFIG_FPU=y
# LVGL
CONFIG_MCUX_ELCDIF_PXP=y
CONFIG_DISPLAY=y
CONFIG_DISPLAY_LOG_LEVEL_ERR=y
CONFIG_LOG_PROCESS_TRIGGER_THRESHOLD=0
CONFIG_LVGL=y
CONFIG_LV_MEM_CUSTOM=y
CONFIG_LV_USE_LOG=y
CONFIG_LV_USE_LABEL=y
CONFIG_LV_USE_BTN=y
CONFIG_LV_USE_ARC=y
CONFIG_LV_USE_IMG=y
CONFIG_LV_USE_MONKEY=y
CONFIG_LV_FONT_MONTSERRAT_14=y
CONFIG_LV_Z_MEM_POOL_SIZE=67224


# Configs from shield rk043fn66hs_ctg's defconfig
CONFIG_LV_Z_VDB_SIZE=100
CONFIG_LV_Z_DOUBLE_VDB=y
CONFIG_LV_Z_FULL_REFRESH=y
CONFIG_LV_Z_BITS_PER_PIXEL=32
CONFIG_LV_DPI_DEF=128
CONFIG_LV_Z_FLUSH_THREAD=n
CONFIG_LV_Z_VDB_ALIGN=32
CONFIG_LV_FONT_DEFAULT_MONTSERRAT_12=y

CONFIG_LV_Z_MEM_POOL_SIZE=67224 
CONFIG_LV_Z_FLUSH_THREAD_STACK_SIZE=17192
CONFIG_LV_Z_MEM_POOL_SYS_HEAP=y
CONFIG_LV_COLOR_DEPTH_32=y

CONFIG_LV_USE_PERF_MONITOR=y


# CONFIG_LV_USE_PXP=y - NO PXP...
```

## boards/native_sim_64.conf
```kconfig
# Copyright 2025 Abderrahmane JARMOUNI
# SPDX-License-Identifier: Apache-2.0

CONFIG_LV_COLOR_DEPTH_32=y
CONFIG_LV_Z_MEM_POOL_SIZE=150536

CONFIG_VE_SIM=y
CONFIG_INPUT=y

CONFIG_NAFE13388=n
CONFIG_DRV8844=n


CONFIG_USE_DT_CODE_PARTITION=n
CONFIG_MCUX_ELCDIF_PXP=n
CONFIG_DISPLAY_MCUX_ELCDIF=n
CONFIG_HW_STACK_PROTECTION=n

CONFIG_BOOTLOADER_MCUBOOT=n
CONFIG_MCUBOOT_GENERATE_UNSIGNED_IMAGE=n
CONFIG_MCUBOOT_BOOTLOADER_MODE_DIRECT_XIP=n
CONFIG_BSP_AUTO_INIT=n
```

## boards/native_sim_64.overlay
```dts
/*
 * Copyright (c) 2025, Abderrahmane JARMOUNI
 *
 * SPDX-License-Identifier: Apache-2.0
 */


/ {	
	aliases {
        debug-uart = &uart0;
        led-green = &led0;
        led-red = &led0;

        i2c = &i2c0;       

        can1-stb = &can0;     
        
    };	
};




    
```

## src/main.c
```c
/*
 * Copyright (c) 2012-2014 Wind River Systems, Inc.
 *
 * SPDX-License-Identifier: Apache-2.0
 */
#include <zephyr/device.h>
#include <zephyr/devicetree.h>
#include <zephyr/drivers/display.h>
#include <zephyr/drivers/gpio.h>
#include <lvgl.h>
#include <stdio.h>
#include <string.h>
#include <zephyr/kernel.h>
#include <lvgl_input_device.h>
#include "bsp.h"
#include <stdio.h>

#ifdef CONFIG_VE_SIM
#include <simulator.h>
#endif


uint32_t count = 0;

#ifdef CONFIG_GPIO
static struct gpio_dt_spec button_gpio = GPIO_DT_SPEC_GET_OR(
		DT_ALIAS(sw0), gpios, {0});
static struct gpio_callback button_callback;

static void button_isr_callback(const struct device *port,
				struct gpio_callback *cb,
				uint32_t pins)
{
	ARG_UNUSED(port);
	ARG_UNUSED(cb);
	ARG_UNUSED(pins);

	count = 0;
}
#endif

static void lv_btn_click_callback(lv_event_t *e)
{
	ARG_UNUSED(e);

	count++;
}

void cb_for_btns(void)
{
	count++;
}

#ifdef CONFIG_LV_Z_ENCODER_INPUT
static const struct device *lvgl_encoder =
	DEVICE_DT_GET(DT_COMPAT_GET_ANY_STATUS_OKAY(zephyr_lvgl_encoder_input));
#endif /* CONFIG_LV_Z_ENCODER_INPUT */

#ifdef CONFIG_LV_Z_KEYPAD_INPUT
static const struct device *lvgl_keypad =
	DEVICE_DT_GET(DT_COMPAT_GET_ANY_STATUS_OKAY(zephyr_lvgl_keypad_input));
#endif /* CONFIG_LV_Z_KEYPAD_INPUT */

int main(void)
{
	bsp_init();
	const struct device *Display_dev;
	lv_obj_t *hello_world_label;
	char count_str[20] = {0};

	Display_dev = DEVICE_DT_GET(DT_CHOSEN(zephyr_display));
	if (!device_is_ready(Display_dev)) {
		return 0;
	}
  

	#ifdef CONFIG_GPIO
	if (gpio_is_ready_dt(&button_gpio)) {
		int err;

		err = gpio_pin_configure_dt(&button_gpio, GPIO_INPUT);
		if (err) {			
			return 0;
		}

		gpio_init_callback(&button_callback, button_isr_callback,
				   BIT(button_gpio.pin));

		err = gpio_add_callback(button_gpio.port, &button_callback);
		if (err) {			
			return 0;
		}

		err = gpio_pin_interrupt_configure_dt(&button_gpio,
						      GPIO_INT_EDGE_TO_ACTIVE);
		if (err) {
			return 0;
		}
	}
#endif /* CONFIG_GPIO */

	printf("%d", IS_ENABLED(CONFIG_LV_Z_POINTER_KSCAN)); 
	printf("%d \n", IS_ENABLED(CONFIG_LV_Z_POINTER_INPUT));
	#ifdef CONFIG_VE_SIM
	create_sim();
	#endif /* CONFIG_VT_SIM */

	lv_obj_t *screen = lv_obj_create(lv_scr_act());	
	lv_obj_set_size(screen, 480, 272);
	lv_obj_set_pos(screen, 50, 50);
	lv_obj_set_scrollbar_mode(screen, LV_SCROLLBAR_MODE_OFF);

	
	hello_world_label = lv_label_create(screen);	
		

	lv_label_set_text(hello_world_label, "Hello world!");
	lv_obj_align(hello_world_label, LV_ALIGN_CENTER, 0, 0);

	lv_obj_t *hello_world_button;

		hello_world_button = lv_btn_create(screen);
		lv_obj_align(hello_world_button, LV_ALIGN_CENTER, 0, -50);
		lv_obj_add_event_cb(hello_world_button, lv_btn_click_callback, LV_EVENT_CLICKED,
				    NULL);

	printf("Hello World! %s\n", CONFIG_BOARD);
	lv_task_handler();
	display_blanking_off(Display_dev);
	
	while (1) {	
		sprintf(count_str, "Hello World! %d", count);
		lv_label_set_text(hello_world_label, count_str);	
		lv_task_handler();	
		k_sleep(K_MSEC(10));
	}

	return 0;
}
```
